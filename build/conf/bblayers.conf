## build/conf/bblayers.conf
```bitbake
# POKY_BBLAYERS_CONF_VERSION is increased each time build/conf/bblayers.conf
# changes incompatibly
POKY_BBLAYERS_CONF_VERSION = "2"

BBPATH = "${TOPDIR}"
BBFILES ?= ""

BBLAYERS ?= " \
  /home/yocto/project/yocto-workspace/poky/meta \
  /home/yocto/project/yocto-workspace/poky/meta-poky \
  /home/yocto/project/yocto-workspace/poky/meta-yocto-bsp \
  "
```
